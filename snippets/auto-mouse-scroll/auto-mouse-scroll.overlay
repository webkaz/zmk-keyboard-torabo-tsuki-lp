#include <input/processors.dtsi>
#include <dt-bindings/zmk/input_transform.h>

/{
    trackball_scroll_listener: trackball_scroll_listener {
        compatible = "zmk,input-listener";
        device = <&trackball>;
        status = "okay";
        input-processors = <&zip_xy_transform (INPUT_TRANSFORM_X_INVERT | INPUT_TRANSFORM_Y_INVERT)>;
     };
};