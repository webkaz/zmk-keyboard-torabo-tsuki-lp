## dts/bindings/zmk,input-listener.yaml
```yaml
description: ZMK input listener
compatible: "zmk,input-listener"

properties:
  device:
    type: phandle
    required: true
    description: Input device to listen to

  layers:
    type: array
    required: false
    description: List of layers this input listener is associated with

  input-processors:
    type: phandles
    required: false
    description: List of input processors to apply to input events
```
